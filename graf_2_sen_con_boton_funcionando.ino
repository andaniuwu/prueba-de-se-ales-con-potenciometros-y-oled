#include <Adafruit_SSD1306.h>  // incluye la libreria de adafruit para el driver del display OLED
#include <Adafruit_GFX.h>  // incluye la libreria de adafruit para gestionar los efectos graficos de manera facil
Adafruit_SSD1306 display(128, 64);  // declara la resolucion del display

int anteriorMillis = 0;
int tiempo = 0;
int a=0;
int ButtonRead;
int ButtonPin=4;

float valorAnalogico = 0;
float voltaje = 0;
float graficaVoltaje = 0;

float valorAnalogicoo = 0;
float voltajee = 0;
float graficaVoltajee = 0;


int x[50]; //buffer de la grafica 
int y[50]; //buffer secundario de la grafica 

int w[50]; //buffer de la grafica 
int z[50]; //buffer secundario de la grafica 



 const unsigned char epd_bitmap_FB_IMG_1577985397610 [] PROGMEM = {
  0xff, 0xff, 0xff, 0xff, 0x3f, 0xff, 0xff, 0xff, 0xff, 0xff, 0xff, 0xff, 0xff, 0xff, 0xff, 0xff, 
  0xff, 0xff, 0xff, 0xff, 0x3f, 0xff, 0xff, 0xff, 0xff, 0xff, 0xff, 0xff, 0xff, 0xff, 0xff, 0xff, 
  0xff, 0xff, 0xff, 0xff, 0x7f, 0xff, 0xff, 0xff, 0xff, 0xff, 0xff, 0xff, 0xff, 0xff, 0xff, 0xff, 
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  0xff, 0xff, 0xff, 0xff, 0x00, 0x00, 0x00, 0x00, 0x00, 0x00, 0x00, 0x00, 0xff, 0xff, 0xff, 0xff
};

// Array of all bitmaps for convenience. (Total bytes used to store images in PROGMEM = 1040)
const int epd_bitmap_allArray_LEN = 1;
const unsigned char* epd_bitmap_allArray[1] = {
  epd_bitmap_FB_IMG_1577985397610
};

void setup(){                

  delay(100);  // se da una espera de 100ms para que el display inicie correctamente
  display.begin(SSD1306_SWITCHCAPVCC, 0x3C);  // inicia la comunicacion I2C con el display que tiene la direccion 0x3C
  display.setRotation(0);  // se escoje la orientacion del display puede ser 0 o 2
  display.dim(true); //dejamos el brillo en maximo
  display.setTextColor(WHITE);
  display.setTextSize(1);  // ajusta el tamaño de texto en el minimo valor


 pinMode(ButtonPin, INPUT);
ButtonRead = digitalRead(ButtonPin);


  //animacion inicial
  for(int i=0;i<1;i++){
    display.clearDisplay();  // limpia el buffer del display
    display.drawBitmap(0,0,epd_bitmap_FB_IMG_1577985397610, 128, 64, 1); // despliega imagen
    display.display(); // muestra la informacion del buffer en la pantalla 
    delay(3000); //pausa 
    display.fillRect(0, 0, 128, 64, 1);
    display.drawBitmap(0,0,epd_bitmap_FB_IMG_1577985397610, 128, 64, 1); // despliega imagen en negativo
    display.display(); // muestra la informacion del buffer en la pantalla 
    delay(1000); //pausa 
    display.clearDisplay(); //limpia buffer
    display.display(); //muestra el buffer limpio
  }

  //llenamos las matrices con un valor fuera del rango de medicion >1023
  for(int i=50;i>=0;i--){
    x[i]=9999;
  }
  for(int i=50;i>=0;i--){
    y[i]=9999;
  }

  for(int i=50;i>=0;i--){
    w[i]=9999;
  }
  for(int i=50;i>=0;i--){
    z[i]=9999;
  }
  
} 

void loop(){

  display.clearDisplay(); //limpia el buffer del display
  
  //dibuja escala
  display.setCursor(0, 0); 
  display.print(F("5V")); 
  display.setCursor(0, 11);   
  display.print(F("4V"));
  display.setCursor(0, 22); 
  display.print(F("3V"));
  display.setCursor(0, 32);  
  display.print(F("2V"));      
  display.setCursor(0, 43); 
  display.print(F("1V")); 

  display.drawLine(15, 0, 25, 0, WHITE);
  display.drawLine(15, 11, 25, 11, WHITE);
  display.drawLine(15, 22, 25, 22, WHITE);
  display.drawLine(15, 32, 25, 32, WHITE);
  display.drawLine(15, 43, 25, 43, WHITE);
 
  //dibuja eje X y Y 
  display.drawLine(0, 53, 127, 53, WHITE);
  display.drawLine(25, 53, 25, 0, WHITE);
 
  valorAnalogico = analogRead(A0); //lee el valor analogico del pin A0
  voltaje=(valorAnalogico*5)/1024; //calcula el valor en voltaje
  graficaVoltaje=map(valorAnalogico,0,1023,127,25); //escala el valor analogico a un pixel imprimible en pantalla

  x[50]=graficaVoltaje; //asigna el valor escalado a el ultimo dato de la matriz




  valorAnalogicoo = analogRead(A1); //lee el valor analogico del pin A0
  voltajee=(valorAnalogicoo*5)/1024; //calcula el valor en voltaje
  graficaVoltajee=map(valorAnalogicoo,0,1023,53,0); //escala el valor analogico a un pixel imprimible en pantalla

  y[50]=graficaVoltajee; //asigna el valor escalado a el ultimo dato de la matriz


  ButtonRead = digitalRead(ButtonPin);

if (ButtonRead==1) {
    

  for(int i=50;i>=0;i--){ 
      display.drawPixel(x[i], y[i], WHITE); //dibuja punto a punto el contenido de x
      a=0;
      w[i-1]=x[i]; //guarda la informacion desplazada una posicion temporalmente en y
      z[i-1]=y[i]; //guarda la informacion desplazada una posicion temporalmente en y

    }
  
  display.display(); //despliega la informacion del buffer en la pantalla
  
//delay(60); //pausa opcional

  for(int i=50;i>=0;i--){
    x[i]=w[i]; //envia los datos desplazados de vuelta a la variable x

    y[i]=z[i]; //envia los datos desplazados de vuelta a la variable x

ButtonRead = digitalRead(ButtonPin);

delayMicroseconds(2);
  } 
  }


else{



      for(int i=50;i>=0;i--){ 
      display.drawPixel(x[i], y[i], WHITE); //dibuja punto a punto el contenido de x
      
      w[i]=x[i]; //guarda la informacion desplazada una posicion temporalmente en y
      z[i]=y[i]; //guarda la informacion desplazada una posicion temporalmente en y

  

       }
  
  display.display(); //despliega la informacion del buffer en la pantalla
  
//delay(60); //pausa opcional

  for(int i=50;i>=0;i--){
    x[i]=w[i]; //envia los datos desplazados de vuelta a la variable x

    y[i]=z[i]; //envia los datos desplazados de vuelta a la variable x

  ButtonRead = digitalRead(ButtonPin);

  delayMicroseconds(2);


}
}

}
